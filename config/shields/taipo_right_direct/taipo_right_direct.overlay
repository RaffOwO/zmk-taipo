/ {
    compatible = "zmk,shield";

    kscan {
        compatible = "zmk,kscan-gpio-direct";

        input-gpios = <
            &gpio0 24 (GPIO_ACTIVE_LOW | GPIO_PULL_UP)  /* pinky1 */
            &gpio0 17 (GPIO_ACTIVE_LOW | GPIO_PULL_UP)  /* pinky2 */

            &gpio0 22 (GPIO_ACTIVE_LOW | GPIO_PULL_UP)  /* ring1 */
            &gpio1 6  (GPIO_ACTIVE_LOW | GPIO_PULL_UP)  /* ring2 */

            &gpio0 20 (GPIO_ACTIVE_LOW | GPIO_PULL_UP)  /* middle1 */
            &gpio1 4  (GPIO_ACTIVE_LOW | GPIO_PULL_UP)  /* middle2 */

            &gpio0 8  (GPIO_ACTIVE_LOW | GPIO_PULL_UP)  /* index1 */
            &gpio1 0  (GPIO_ACTIVE_LOW | GPIO_PULL_UP)  /* index2 */

            &gpio0 10 (GPIO_ACTIVE_LOW | GPIO_PULL_UP)  /* thumb1 */
            &gpio0 9  (GPIO_ACTIVE_LOW | GPIO_PULL_UP)  /* thumb2 */
        >;
    };
};
